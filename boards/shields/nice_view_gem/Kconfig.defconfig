## boards/shields/nice_view_gem/Kconfig.defconfig
```kconfig
if SHIELD_NICE_VIEW_GEM

config TOUCAN_STATUS_SCREEN
    int "Status screen style (0 to 2)"
    default 2
    range 0 2

config ZMK_BT_PROFILE_0_NAME
    string "Label drawn on the display for BT profile 1"
    default ""
    help
      Shown next to the profile dots. Empty = no label.

config ZMK_BT_PROFILE_1_NAME
    string "Label drawn on the display for BT profile 2"
    default ""

config ZMK_BT_PROFILE_2_NAME
    string "Label drawn on the display for BT profile 3"
    default ""

config ZMK_BT_PROFILE_3_NAME
    string "Label drawn on the display for BT profile 4"
    default ""

config ZMK_BT_PROFILE_4_NAME
    string "Label drawn on the display for BT profile 5"
    default ""

config LV_Z_VDB_SIZE
    default 100

config LV_DPI_DEF
    default 161

config LV_Z_BITS_PER_PIXEL
    default 1

choice LV_COLOR_DEPTH
    default LV_COLOR_DEPTH_1
endchoice

choice ZMK_DISPLAY_WORK_QUEUE
    default ZMK_DISPLAY_WORK_QUEUE_DEDICATED
endchoice

choice ZMK_DISPLAY_STATUS_SCREEN
    default ZMK_DISPLAY_STATUS_SCREEN_CUSTOM
endchoice

config LV_Z_MEM_POOL_SIZE
    default 4096 if ZMK_DISPLAY_STATUS_SCREEN_CUSTOM

config ZMK_DISPLAY_STATUS_SCREEN_CUSTOM
    imply NICE_VIEW_WIDGET_STATUS

config NICE_VIEW_WIDGET_STATUS
    default y
    select LV_USE_LABEL
    select LV_USE_IMG
    select LV_USE_CANVAS
    select LV_USE_ANIMIMG
    select LV_USE_ANIMATION
    select ZMK_WPM

config NICE_VIEW_WIDGET_INVERTED
    bool "Invert display colors"

if !ZMK_SPLIT || ZMK_SPLIT_ROLE_CENTRAL


endif # !ZMK_SPLIT || ZMK_SPLIT_ROLE_CENTRAL

endif # SHIELD_NICE_VIEW_GEM
```
